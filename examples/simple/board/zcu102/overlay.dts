/*
 * Copyright 2026, DornerWorks
 *
 * SPDX-License-Identifier: BSD-2-Clause
 */
/ {
	chosen {
		bootargs = "console=ttyPS0,115200 root=/dev/ram0 maxcpus=1 nosmp clk_ignore_unused earlycon debug loglevel=8";
		stdout-path = "serial0:115200n8";
		#size-cells = <0x02>;
		linux,initrd-start = <0x08 0x0D000000>;
		linux,initrd-end = <0x8 0x0E000000>;
	};

	memory@0 {
		device_type = "memory";
		reg = <0x08 0x00000000 0x00 0x10000000>;
	};
};

&serial0 {
	status = "okay";
};
