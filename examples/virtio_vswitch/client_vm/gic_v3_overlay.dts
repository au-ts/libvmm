/*
 * Copyright 2025, UNSW
 *
 * SPDX-License-Identifier: BSD-2-Clause
 */

/ {
	interrupt-controller@38800000 {
		compatible = "arm,gic-v3";
		reg = <0x0 0x38800000 0x0 0x10000 0x0 0x38880000 0x0 0xc0000 0x0 0x31000000 0x0 0x2000 0x0 0x31010000 0x0 0x2000 0x0 0x31020000 0x0 0x2000>;
		#interrupt-cells = <0x03>;
		interrupt-controller;
		interrupts = <0x01 0x09 0x04>;
		interrupt-parent = <0x07>;
		phandle = <0x8001>;
	};
};
