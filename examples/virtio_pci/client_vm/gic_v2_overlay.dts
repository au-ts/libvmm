/*
 * Copyright 2025, UNSW
 *
 * SPDX-License-Identifier: BSD-2-Clause
 */

/ {
	intc@8000000 {
		phandle = <0x8001>;
		interrupts = <0x01 0x09 0x04>;
		reg = <0x00 0x8000000 0x00 0x10000 0x00 0x8010000 0x00 0x10000 0x00 0x8030000 0x00 0x10000 0x00 0x8040000 0x00 0x10000>;
		compatible = "arm,cortex-a15-gic";
		ranges;
		#size-cells = <0x02>;
		interrupt-controller;
		#interrupt-cells = <0x03>;
	};

    pci@10000000 {
        compatible = "pci-host-ecam-generic";
        device_type = "pci";
        #address-cells = <3>;
        #size-cells = <2>;
        #interrupt-cells = <1>;

        /* PCI bus range */
        bus-range = <0x00 0x00>;

        /* Register space for ECAM configuration */
        reg = <0x0 0x10000000 0x0 0x100000>;  /* 256MB ECAM space */

        /* Memory and I/O ranges */
        ranges = <0x02000000 0x0 0x20100000  0x0 0x20100000  0x0 0x0ff00000>;  /* 32-bit memory */

        /* Interrupt mapping */
        interrupt-map-mask = <0x1800 0x0 0x0 0x7>;
        interrupt-map = <0x0000 0x0 0x0 0x1 0x8001 0x0 0x10 0x4>,
                        <0x0800 0x0 0x0 0x1 0x8001 0x0 0x11 0x4>,
                        <0x1000 0x0 0x0 0x1 0x8001 0x0 0x12 0x4>;

        interrupt-parent = <0x8001>;

        /* MSI controller reference (optional) */
        /* msi-parent = <&its>; */
    };

};
