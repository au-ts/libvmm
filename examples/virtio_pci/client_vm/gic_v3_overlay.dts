/*
 * Copyright 2025, UNSW
 *
 * SPDX-License-Identifier: BSD-2-Clause
 */

/ {
	interrupt-controller@38800000 {
		compatible = "arm,gic-v3";
		reg = <0x0 0x38800000 0x0 0x10000 0x0 0x38880000 0x0 0xc0000 0x0 0x31000000 0x0 0x2000 0x0 0x31010000 0x0 0x2000 0x0 0x31020000 0x0 0x2000>;
		#interrupt-cells = <0x03>;
		interrupt-controller;
		interrupts = <0x01 0x09 0x04>;
		interrupt-parent = <0x07>;
		phandle = <0x8001>;
	};

    pci@10000000 {
        compatible = "pci-host-ecam-generic";
        device_type = "pci";
        #address-cells = <3>;
        #size-cells = <2>;
        #interrupt-cells = <1>;

        /* PCI bus range */
        bus-range = <0x00 0x00>;

        /* Register space for ECAM configuration */
        reg = <0x0 0x10000000 0x0 0x100000>;  /* 256MB ECAM space */

        /* Memory and I/O ranges */
        ranges = <0x02000000 0x0 0x20100000  0x0 0x20100000  0x0 0x0ff00000>;  /* 32-bit memory */

        /* Interrupt mapping */
        interrupt-map-mask = <0x1800 0x0 0x0 0x7>;
        interrupt-map = <0x0000 0x0 0x0 0x1 0x8001 0x0 0x10 0x4>,
                        <0x0000 0x0 0x0 0x2 0x8001 0x0 0x11 0x4>,
                        <0x0000 0x0 0x0 0x3 0x8001 0x0 0x12 0x4>,
                        <0x0000 0x0 0x0 0x4 0x8001 0x0 0x13 0x4>;

        interrupt-parent = <0x8001>;

        /* MSI controller reference (optional) */
        /* msi-parent = <&its>; */
    };

};
