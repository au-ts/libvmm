/ {
    /delete-node/ memory@40000000;
    /delete-node/ chosen;

    memory@40000000 {
		reg = <0x00 0x40000000 0x00 0x8000000>;
		device_type = "memory";
	};

	chosen {
		stdout-path = "/pl011@9000000";
		bootargs = "earlyprintk=serial debug loglevel=8 uio_pdrv_genirq.of_id=generic-uio";
		linux,stdout-path = "/pl011@9000000";
		linux,initrd-start = <0x47000000>;
		linux,initrd-end = <0x47f00000>;
	};

	// enable/disable console serial for debugging
	/delete-node/ pl011@9000000;
	pl011@9000000 {
		clock-names = "uartclk\0apb_pclk";
		clocks = <0x8000 0x8000>;
		interrupts = <0x00 0x01 0x04>;
		reg = <0x00 0x9000000 0x00 0x1000>;
		compatible = "arm,pl011\0arm,primecell";
		status = "okay";
		// status = "disabled";
	};
};