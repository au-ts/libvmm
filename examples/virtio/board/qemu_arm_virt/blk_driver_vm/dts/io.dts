/ {
	virtio-console@0130000 {
		compatible = "virtio,mmio";
		reg = <0x00 0x130000 0x00 0x200>;
		interrupts = <0x00 42 0x04>;
	};

	uio0 {
		compatible = "generic-uio\0uio";
		reg = <
			0x00 0x29800000 0x00 0x1000
			0x00 0x20000000 0x00 0x1000
			0x00 0x20200000 0x00 0x200000
			0x00 0x20400000 0x00 0x200000
			0x00 0x20800000 0x00 0x200000
		>;
		interrupts = <0x00 18 0x04>;
		// IRQ = 50
	};
};