/ {
	virtio-console@0130000 {
		compatible = "virtio,mmio";
		reg = <0x00 0x130000 0x00 0x200>;
		interrupts = <0x00 42 0x04>;
	};

	virtio-net@0190000 {
		compatible = "virtio,mmio";
		reg = <0x00 0x190000 0x00 0x1000>;
		interrupts = <0x00 45 0x04>;
		// IRQ number = 77
	};
};