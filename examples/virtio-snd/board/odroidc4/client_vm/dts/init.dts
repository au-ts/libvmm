/ {
	memory@0 {
		reg = <0x00 0x20000000 0x00 0x8000000>;
		device_type = "memory";
	};

	chosen {
		bootargs = "console=hvc0 earlycon=hvc0 earlyprintk=serial debug loglevel=8";
        linux,stdout-path = "/virtio-console@0130000";
        stdout-path = "/virtio-console@0130000";
		linux,initrd-start = <0x26000000>;
		linux,initrd-end = <0x27000000>;
	};
};
