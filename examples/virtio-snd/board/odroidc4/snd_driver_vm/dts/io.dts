/ {
	// virtio-console@0130000 {
	// 	compatible = "virtio,mmio";
	// 	reg = <0x00 0x130000 0x00 0x200>;
	// 	interrupts = <0x00 42 0x04>;
	// };

	uio {
		compatible = "generic-uio\0uio";
		reg = <
			0x00 0x6f00000 0x00 0x1000
			0x00 0x7000000 0x00 0xC00000
			0x00 0x9400000 0x00 0x200000
		>;
		interrupts = <0x00 0x12 0x04>;
	};
};
