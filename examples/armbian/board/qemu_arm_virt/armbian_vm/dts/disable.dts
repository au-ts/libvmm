/ {
    // enable/disable console serial for debugging
	/delete-node/ pl011@9000000;
	pl011@9000000 {
		clock-names = "uartclk\0apb_pclk";
		clocks = <0x8000 0x8000>;
		interrupts = <0x00 0x01 0x04>;
		reg = <0x00 0x9000000 0x00 0x1000>;
		compatible = "arm,pl011\0arm,primecell";
		status = "okay";
		// status = "disabled";
	};

	// Remove GICv2m from interrupt controller node
	/delete-node/ intc@8000000;
	intc@8000000 {
		phandle = <0x8002>;
		interrupts = <0x01 0x09 0x04>;
		reg = <0x00 0x8000000 0x00 0x10000 0x00 0x8010000 0x00 0x10000 0x00 0x8030000 0x00 0x10000 0x00 0x8040000 0x00 0x10000>;
		compatible = "arm,cortex-a15-gic";
		ranges;
		#size-cells = <0x02>;
		#address-cells = <0x02>;
		interrupt-controller;
		#interrupt-cells = <0x03>;
	};

	/delete-node/ pcie@10000000;
	/delete-node/ pl031@9010000;
	/delete-node/ pl061@9030000;
	/delete-node/ fw-cfg@9020000;
	/delete-node/ flash@0;

	// Delete all other virtio mmio devices
	/delete-node/ virtio_mmio@a000000;
	/delete-node/ virtio_mmio@a000200;
	/delete-node/ virtio_mmio@a000400;
	/delete-node/ virtio_mmio@a000600;
	/delete-node/ virtio_mmio@a000800;
	/delete-node/ virtio_mmio@a000a00;
	/delete-node/ virtio_mmio@a000c00;
	/delete-node/ virtio_mmio@a000e00;
	/delete-node/ virtio_mmio@a001000;
	/delete-node/ virtio_mmio@a001200;
	/delete-node/ virtio_mmio@a001400;
	/delete-node/ virtio_mmio@a001600;
	/delete-node/ virtio_mmio@a001800;
	/delete-node/ virtio_mmio@a001a00;
	/delete-node/ virtio_mmio@a001c00;
	/delete-node/ virtio_mmio@a001e00;
	/delete-node/ virtio_mmio@a002000;
	/delete-node/ virtio_mmio@a002200;
	/delete-node/ virtio_mmio@a002400;
	/delete-node/ virtio_mmio@a002600;
	/delete-node/ virtio_mmio@a002800;
	/delete-node/ virtio_mmio@a002a00;
	/delete-node/ virtio_mmio@a002c00;
	/delete-node/ virtio_mmio@a002e00;
	/delete-node/ virtio_mmio@a003000;
	/delete-node/ virtio_mmio@a003200;
	/delete-node/ virtio_mmio@a003400;
	/delete-node/ virtio_mmio@a003600;
	/delete-node/ virtio_mmio@a003800;
	/delete-node/ virtio_mmio@a003a00;
	/delete-node/ virtio_mmio@a003c00;
	// /delete-node/ virtio_mmio@a003e00;
};