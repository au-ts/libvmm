/ {
    /delete-node/ memory@0;
    /delete-node/ chosen;

    memory@0 {
		device_type = "memory";
		reg = <0x00 0x20000000 0x00 0x10000000>;
	};

	chosen {
		#address-cells = <0x02>;
		#size-cells = <0x02>;
		ranges;
        linux,stdout-path = "/soc/bus@ff800000/serial@3000";
        stdout-path = "/soc/bus@ff800000/serial@3000";
		linux,initrd-end = <0x00000000 0x2e000000>;
        linux,initrd-start = <0x00000000 0x2d700000>;
        bootargs = "console=ttyAML0,115200n8 root=/dev/ram0 nosmp rw debug loglevel=8 pci=nomsi earlyprintk=serial maxcpus=1";

		/delete-node/ framebuffer-cvbs;
		/delete-node/ framebuffer-hdmi;
	};
};